// Regression: the real legacy EEPROM (0..282) dumped from Kilo, a Nybble
// calibrated with the Petoi setup sketch and legacy firmware, just before the
// first flash of the new body firmware. It must always import as MIGRATED.
// On 2026-10-10 it came up DEFAULTED (reason DIRECTION): joint 2 (tail) is
// +1 in Kilo's ROTATION_DIRECTION, and the model table had -1.
#include "fake_eeprom.h"
#include "check.h"

static const uint8_t KILO_LEGACY[283] = {
    0x0c, 0x0b, 0x04, 0x03, 0x0d, 0x0a, 0x05, 0x02, 0x0e, 0x09, 0x06, 0x01, 0x0f, 0x08, 0x07, 0x00,  // 0
    0xef, 0x06, 0xfb, 0x00, 0x00, 0x00, 0x00, 0x00, 0x0b, 0xfd, 0xf0, 0x02, 0xeb, 0x07, 0x07, 0x01,  // 16
    0x00, 0x0f, 0x00, 0x00, 0xd3, 0xd3, 0xd3, 0xd3, 0x0a, 0x0a, 0xf6, 0xf6, 0xe2, 0xe2, 0x1e, 0x1e,  // 32
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    0xff, 0xff, 0x3c, 0x54, 0x61, 0x2f, 0x11, 0x1b, 0xff, 0xff, 0x01,                                // 272
};

// Decoded by hand from the dump: CALIB @16 (int8), CALIBRATED_ZERO_POSITIONS
// @96 (int16), ANGLE2PULSE_FACTOR @160 (all 10963), B_OFFSET @274 (60),
// PCA9685_FREQ @275 (24916), MPUCALIB @256 (accel xyz, gyro xyz).
static const int8_t CALIB[16] = {-17, 6, -5, 0, 0, 0, 0, 0, 11, -3, -16, 2, -21, 7, 7, 1};
static const int16_t CZP[16] = {73, 69, 85, 90, 45, 135, 45, 135, 111, 83, 116, 82, 141, 67, 127, 59};
static const int16_t MPU[6] = {-2199, -257, 727, 82, 23, -17};

static void load_dump() {
  g_ee.reset();
  std::memcpy(g_ee.mem, KILO_LEGACY, sizeof KILO_LEGACY);
}

int main() {
  // 1. Migration alone.
  load_dump();
  ConfigSlot s;
  ConfigReason r = config_migrate(s);
  CHECKF(r == CFG_REASON_NONE, "Kilo dump rejected: reason %d", r);
  for (uint8_t k = 0; k < DRIVEN_COUNT; k++) {
    uint8_t j = joint_id(k);
    CHECKF(s.cal.zero_a16[j] == CZP[j] * 16, "joint %d zero_a16 %d", j, s.cal.zero_a16[j]);
    CHECKF(s.cal.a2p[j] == 10963, "joint %d a2p %d", j, s.cal.a2p[j]);
    // The protocol's calib is exactly the legacy CALIB byte.
    CHECKF(config_calib_a16(s, j) == CALIB[j] * 16, "joint %d calib_a16 %d", j, config_calib_a16(s, j));
  }
  CHECK(s.cal.b_offset_counts == 600);
  CHECK(s.pca9685_freq_khz == 24916);
  // 2. The MPU offsets are the six legacy MPUCALIB ints, in register order
  //    (hal/mpu6050 writes them to XA_OFFS_H.. and XG_OFFS_USRH.. at init).
  for (int i = 0; i < 6; i++) CHECKF(s.imu_offset[i] == MPU[i], "imu_offset[%d] = %d", i, s.imu_offset[i]);
  CHECK(config_slot_valid(s));

  // 3. Full boot: MIGRATED, slot A written, legacy bytes untouched, and the
  //    next boot loads the same image (offsets included) from slot A.
  load_dump();
  Config c;
  config_boot(c);
  CHECKF(c.state == CFG_MIGRATED && c.reason == CFG_REASON_NONE, "boot state %d reason %d", c.state, c.reason);
  while (config_busy(c)) config_writer_step(c);
  CHECK(std::memcmp(g_ee.mem, KILO_LEGACY, sizeof KILO_LEGACY) == 0);
  for (uint16_t a : g_ee.writes) CHECK(a >= CFG_REGION_START && a < CFG_REGION_END);
  Config c2;
  config_boot(c2);
  CHECK(c2.state == CFG_OK && c2.newest == 0);
  for (int i = 0; i < 6; i++) CHECK(c2.img.imu_offset[i] == MPU[i]);
  return report("kilo_eeprom");
}
